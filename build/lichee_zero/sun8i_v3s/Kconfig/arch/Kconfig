## build/lichee_zero/sun8i_v3s/Kconfig/arch/Kconfig
```kconfig
# Load Zephyr Arch Kconfig descriptions.
osource "/home/juno/Documents/zephyrproject/zephyr/arch/rx/Kconfig"
osource "/home/juno/Documents/zephyrproject/zephyr/arch/x86/Kconfig"
osource "/home/juno/Documents/zephyrproject/zephyr/arch/xtensa/Kconfig"
osource "/home/juno/Documents/zephyrproject/zephyr/arch/sparc/Kconfig"
osource "/home/juno/Documents/zephyrproject/zephyr/arch/riscv/Kconfig"
osource "/home/juno/Documents/zephyrproject/zephyr/arch/posix/Kconfig"
osource "/home/juno/Documents/zephyrproject/zephyr/arch/openrisc/Kconfig"
osource "/home/juno/Documents/zephyrproject/zephyr/arch/mips/Kconfig"
osource "/home/juno/Documents/zephyrproject/zephyr/arch/arm64/Kconfig"
osource "/home/juno/Documents/zephyrproject/zephyr/arch/arm/Kconfig"
osource "/home/juno/Documents/zephyrproject/zephyr/arch/arc/Kconfig"
```

## build/lichee_zero/sun8i_v3s/Kconfig/boards/Kconfig
```kconfig
# Load Zephyr board Kconfig descriptions.
osource "/home/juno/Documents/zephyrproject/zephyr/boards/sipeed/lichee_zero/Kconfig"
```

## build/lichee_zero/sun8i_v3s/Kconfig/boards/Kconfig.defconfig
```kconfig
# Load Zephyr board defconfig descriptions.
osource "/home/juno/Documents/zephyrproject/zephyr/boards/sipeed/lichee_zero/Kconfig.defconfig"
```

## build/lichee_zero/sun8i_v3s/Kconfig/boards/Kconfig.lichee_zero
```kconfig
# Load board Kconfig descriptions.
osource "/home/juno/Documents/zephyrproject/zephyr/boards/sipeed/lichee_zero/Kconfig.lichee_zero"
```

## build/lichee_zero/sun8i_v3s/Kconfig/boards/Kconfig.sysbuild
```kconfig
# Load Sysbuild board Kconfig descriptions.
osource "/home/juno/Documents/zephyrproject/zephyr/boards/sipeed/lichee_zero/Kconfig.sysbuild"
```

## build/lichee_zero/sun8i_v3s/Kconfig/soc/Kconfig
```kconfig
# Load Zephyr SoC Kconfig descriptions.
osource "/home/juno/Documents/zephyrproject/zephyr/soc/xlnx/zynqmp/Kconfig"
osource "/home/juno/Documents/zephyrproject/zephyr/soc/xlnx/zynq7000/Kconfig"
osource "/home/juno/Documents/zephyrproject/zephyr/soc/xlnx/versalnet/Kconfig"
osource "/home/juno/Documents/zephyrproject/zephyr/soc/xlnx/versal2/Kconfig"
osource "/home/juno/Documents/zephyrproject/zephyr/soc/xlnx/versal/Kconfig"
osource "/home/juno/Documents/zephyrproject/zephyr/soc/xen/Kconfig"
osource "/home/juno/Documents/zephyrproject/zephyr/soc/wch/ch32v/Kconfig"
osource "/home/juno/Documents/zephyrproject/zephyr/soc/ti/simplelink/Kconfig"
osource "/home/juno/Documents/zephyrproject/zephyr/soc/ti/mspm0/Kconfig"
osource "/home/juno/Documents/zephyrproject/zephyr/soc/ti/lm3s6965/Kconfig"
osource "/home/juno/Documents/zephyrproject/zephyr/soc/ti/k3/Kconfig"
osource "/home/juno/Documents/zephyrproject/zephyr/soc/telink/tlsr/Kconfig"
osource "/home/juno/Documents/zephyrproject/zephyr/soc/syna/sr100/Kconfig"
osource "/home/juno/Documents/zephyrproject/zephyr/soc/starfive/jh71xx/Kconfig"
osource "/home/juno/Documents/zephyrproject/zephyr/soc/st/stm32/Kconfig"
osource "/home/juno/Documents/zephyrproject/zephyr/soc/snps/qemu_arc/Kconfig"
osource "/home/juno/Documents/zephyrproject/zephyr/soc/snps/nsim/arc_v/Kconfig"
osource "/home/juno/Documents/zephyrproject/zephyr/soc/snps/nsim/arc_classic/Kconfig"
osource "/home/juno/Documents/zephyrproject/zephyr/soc/snps/hsdk4xd/Kconfig"
osource "/home/juno/Documents/zephyrproject/zephyr/soc/snps/hsdk/Kconfig"
osource "/home/juno/Documents/zephyrproject/zephyr/soc/snps/emsk/Kconfig"
osource "/home/juno/Documents/zephyrproject/zephyr/soc/snps/emsdp/Kconfig"
osource "/home/juno/Documents/zephyrproject/zephyr/soc/snps/arc_iot/Kconfig"
osource "/home/juno/Documents/zephyrproject/zephyr/soc/silabs/Kconfig"
osource "/home/juno/Documents/zephyrproject/zephyr/soc/sifli/sf32/Kconfig"
osource "/home/juno/Documents/zephyrproject/zephyr/soc/sifive/sifive_freedom/Kconfig"
osource "/home/juno/Documents/zephyrproject/zephyr/soc/sensry/Kconfig"
osource "/home/juno/Documents/zephyrproject/zephyr/soc/rockchip/Kconfig"
osource "/home/juno/Documents/zephyrproject/zephyr/soc/renode/riscv_virtual/Kconfig"
osource "/home/juno/Documents/zephyrproject/zephyr/soc/renode/cortex_r8_virtual/Kconfig"
osource "/home/juno/Documents/zephyrproject/zephyr/soc/renesas/smartbond/Kconfig"
osource "/home/juno/Documents/zephyrproject/zephyr/soc/renesas/rz/Kconfig"
osource "/home/juno/Documents/zephyrproject/zephyr/soc/renesas/rx/Kconfig"
osource "/home/juno/Documents/zephyrproject/zephyr/soc/renesas/rcar/Kconfig"
osource "/home/juno/Documents/zephyrproject/zephyr/soc/renesas/ra/Kconfig"
osource "/home/juno/Documents/zephyrproject/zephyr/soc/realtek/fingerprint/Kconfig"
osource "/home/juno/Documents/zephyrproject/zephyr/soc/realtek/ec/Kconfig"
osource "/home/juno/Documents/zephyrproject/zephyr/soc/realtek/bee/Kconfig"
osource "/home/juno/Documents/zephyrproject/zephyr/soc/realtek/ameba/Kconfig"
osource "/home/juno/Documents/zephyrproject/zephyr/soc/raspberrypi/rpi_pico/Kconfig"
osource "/home/juno/Documents/zephyrproject/zephyr/soc/quicklogic/eos_s3/Kconfig"
osource "/home/juno/Documents/zephyrproject/zephyr/soc/qemu/virt_riscv/Kconfig"
osource "/home/juno/Documents/zephyrproject/zephyr/soc/qemu/or1k/Kconfig"
osource "/home/juno/Documents/zephyrproject/zephyr/soc/qemu/malta/Kconfig"
osource "/home/juno/Documents/zephyrproject/zephyr/soc/openisa/rv32m1/Kconfig"
osource "/home/juno/Documents/zephyrproject/zephyr/soc/openhwgroup/cva6/Kconfig"
osource "/home/juno/Documents/zephyrproject/zephyr/soc/oct/osd32mp15x/Kconfig"
osource "/home/juno/Documents/zephyrproject/zephyr/soc/nxp/s32/Kconfig"
osource "/home/juno/Documents/zephyrproject/zephyr/soc/nxp/rw/Kconfig"
osource "/home/juno/Documents/zephyrproject/zephyr/soc/nxp/mcx/Kconfig"
osource "/home/juno/Documents/zephyrproject/zephyr/soc/nxp/lpc/Kconfig"
osource "/home/juno/Documents/zephyrproject/zephyr/soc/nxp/layerscape/Kconfig"
osource "/home/juno/Documents/zephyrproject/zephyr/soc/nxp/kinetis/Kconfig"
osource "/home/juno/Documents/zephyrproject/zephyr/soc/nxp/imxrt/Kconfig"
osource "/home/juno/Documents/zephyrproject/zephyr/soc/nxp/imx/Kconfig"
osource "/home/juno/Documents/zephyrproject/zephyr/soc/nuvoton/numicro/Kconfig"
osource "/home/juno/Documents/zephyrproject/zephyr/soc/nuvoton/numaker/Kconfig"
osource "/home/juno/Documents/zephyrproject/zephyr/soc/nuvoton/npcx/Kconfig"
osource "/home/juno/Documents/zephyrproject/zephyr/soc/nuvoton/npcm/Kconfig"
osource "/home/juno/Documents/zephyrproject/zephyr/soc/nordic/Kconfig"
osource "/home/juno/Documents/zephyrproject/zephyr/soc/neorv32/Kconfig"
osource "/home/juno/Documents/zephyrproject/zephyr/soc/native/inf_clock/Kconfig"
osource "/home/juno/Documents/zephyrproject/zephyr/soc/microchip/sam/sama7/Kconfig"
osource "/home/juno/Documents/zephyrproject/zephyr/soc/microchip/sam/sam_d5x_e5x/Kconfig"
osource "/home/juno/Documents/zephyrproject/zephyr/soc/microchip/pic64/Kconfig"
osource "/home/juno/Documents/zephyrproject/zephyr/soc/microchip/pic32c/pic32cz_ca/Kconfig"
osource "/home/juno/Documents/zephyrproject/zephyr/soc/microchip/pic32c/pic32cx_sg/Kconfig"
osource "/home/juno/Documents/zephyrproject/zephyr/soc/microchip/pic32c/pic32cm_sg_gc/Kconfig"
osource "/home/juno/Documents/zephyrproject/zephyr/soc/microchip/pic32c/pic32cm_pl/Kconfig"
osource "/home/juno/Documents/zephyrproject/zephyr/soc/microchip/pic32c/pic32cm_jh/Kconfig"
osource "/home/juno/Documents/zephyrproject/zephyr/soc/microchip/pic32c/pic32ck_sg_gc/Kconfig"
osource "/home/juno/Documents/zephyrproject/zephyr/soc/microchip/miv/Kconfig"
osource "/home/juno/Documents/zephyrproject/zephyr/soc/microchip/mec/Kconfig"
osource "/home/juno/Documents/zephyrproject/zephyr/soc/mediatek/mt8xxx/Kconfig"
osource "/home/juno/Documents/zephyrproject/zephyr/soc/lowrisc/opentitan/Kconfig"
osource "/home/juno/Documents/zephyrproject/zephyr/soc/litex/Kconfig"
osource "/home/juno/Documents/zephyrproject/zephyr/soc/ite/ec/Kconfig"
osource "/home/juno/Documents/zephyrproject/zephyr/soc/intel/wildcat_lake/Kconfig"
osource "/home/juno/Documents/zephyrproject/zephyr/soc/intel/raptor_lake/Kconfig"
osource "/home/juno/Documents/zephyrproject/zephyr/soc/intel/panther_lake/Kconfig"
osource "/home/juno/Documents/zephyrproject/zephyr/soc/intel/lakemont/Kconfig"
osource "/home/juno/Documents/zephyrproject/zephyr/soc/intel/intel_socfpga_std/Kconfig"
osource "/home/juno/Documents/zephyrproject/zephyr/soc/intel/intel_socfpga/Kconfig"
osource "/home/juno/Documents/zephyrproject/zephyr/soc/intel/intel_niosv/Kconfig"
osource "/home/juno/Documents/zephyrproject/zephyr/soc/intel/intel_ish/Kconfig"
osource "/home/juno/Documents/zephyrproject/zephyr/soc/intel/intel_adsp/Kconfig"
osource "/home/juno/Documents/zephyrproject/zephyr/soc/intel/elkhart_lake/Kconfig"
osource "/home/juno/Documents/zephyrproject/zephyr/soc/intel/atom/Kconfig"
osource "/home/juno/Documents/zephyrproject/zephyr/soc/intel/apollo_lake/Kconfig"
osource "/home/juno/Documents/zephyrproject/zephyr/soc/intel/alder_lake/Kconfig"
osource "/home/juno/Documents/zephyrproject/zephyr/soc/infineon/psoc4/Kconfig"
osource "/home/juno/Documents/zephyrproject/zephyr/soc/infineon/edge/Kconfig"
osource "/home/juno/Documents/zephyrproject/zephyr/soc/infineon/cat3/Kconfig"
osource "/home/juno/Documents/zephyrproject/zephyr/soc/infineon/cat1c/Kconfig"
osource "/home/juno/Documents/zephyrproject/zephyr/soc/infineon/cat1b/Kconfig"
osource "/home/juno/Documents/zephyrproject/zephyr/soc/infineon/cat1a/Kconfig"
osource "/home/juno/Documents/zephyrproject/zephyr/soc/gd/gd32/Kconfig"
osource "/home/juno/Documents/zephyrproject/zephyr/soc/gaisler/leon3/Kconfig"
osource "/home/juno/Documents/zephyrproject/zephyr/soc/gaisler/gr716a/Kconfig"
osource "/home/juno/Documents/zephyrproject/zephyr/soc/focaltech/Kconfig"
osource "/home/juno/Documents/zephyrproject/zephyr/soc/espressif/Kconfig"
osource "/home/juno/Documents/zephyrproject/zephyr/soc/ene/kb1200/Kconfig"
osource "/home/juno/Documents/zephyrproject/zephyr/soc/ene/kb106x/Kconfig"
osource "/home/juno/Documents/zephyrproject/zephyr/soc/elan/em32f967/Kconfig"
osource "/home/juno/Documents/zephyrproject/zephyr/soc/egis/Kconfig"
osource "/home/juno/Documents/zephyrproject/zephyr/soc/efinix/sapphire/Kconfig"
osource "/home/juno/Documents/zephyrproject/zephyr/soc/cdns/xtensa_sample_controller/Kconfig"
osource "/home/juno/Documents/zephyrproject/zephyr/soc/cdns/swerv/Kconfig"
osource "/home/juno/Documents/zephyrproject/zephyr/soc/cdns/sample_controller32/Kconfig"
osource "/home/juno/Documents/zephyrproject/zephyr/soc/cdns/dc233c/Kconfig"
osource "/home/juno/Documents/zephyrproject/zephyr/soc/brcm/bcmvk/Kconfig"
osource "/home/juno/Documents/zephyrproject/zephyr/soc/brcm/bcm2712/Kconfig"
osource "/home/juno/Documents/zephyrproject/zephyr/soc/brcm/bcm2711/Kconfig"
osource "/home/juno/Documents/zephyrproject/zephyr/soc/blackberry/qnxhv_vm/Kconfig"
osource "/home/juno/Documents/zephyrproject/zephyr/soc/bflb/Kconfig"
osource "/home/juno/Documents/zephyrproject/zephyr/soc/atmel/sam0/Kconfig"
osource "/home/juno/Documents/zephyrproject/zephyr/soc/atmel/sam/Kconfig"
osource "/home/juno/Documents/zephyrproject/zephyr/soc/aspeed/Kconfig"
osource "/home/juno/Documents/zephyrproject/zephyr/soc/arm/Kconfig"
osource "/home/juno/Documents/zephyrproject/zephyr/soc/arm/beetle/Kconfig"
osource "/home/juno/Documents/zephyrproject/zephyr/soc/antmicro/myra/Kconfig"
osource "/home/juno/Documents/zephyrproject/zephyr/soc/andestech/Kconfig"
osource "/home/juno/Documents/zephyrproject/zephyr/soc/amd/acp_7_x/Kconfig"
osource "/home/juno/Documents/zephyrproject/zephyr/soc/amd/acp_7_0/Kconfig"
osource "/home/juno/Documents/zephyrproject/zephyr/soc/amd/acp_6_0/Kconfig"
osource "/home/juno/Documents/zephyrproject/zephyr/soc/ambiq/Kconfig"
osource "/home/juno/Documents/zephyrproject/zephyr/soc/allwinner/sun8i_v3s/Kconfig"
osource "/home/juno/Documents/zephyrproject/zephyr/soc/allwinner/sun8i_h3/Kconfig"
osource "/home/juno/Documents/zephyrproject/zephyr/soc/allwinner/sun50i_h618/Kconfig"
osource "/home/juno/Documents/zephyrproject/zephyr/soc/alif/ensemble/Kconfig"
osource "/home/juno/Documents/zephyrproject/zephyr/soc/alif/balletto/Kconfig"
osource "/home/juno/Documents/zephyrproject/zephyr/soc/aesc/Kconfig"
osource "/home/juno/Documents/zephyrproject/zephyr/soc/adi/max32/Kconfig"
```
